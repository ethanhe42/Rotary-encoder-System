#include "all.h"
#define POLYSIZE 100
struct PPoly
{
	int  num;
	fp64 breaks[POLYSIZE];
	fp64 coefs[POLYSIZE][4];
};
fp64  Gyro_Convert1=-1.6068;    //正转系数
fp64  Gyro_Convert2=-1.6068;	//反转系数

// 校陀螺仪零漂用到的
int32_t Gyro_Float=0;
uint8_t Float_State;
uint8_t Gyro_Float_Flag1=0;
uint8_t Gyro_Float_Flag2=0;
uint8_t Gyro_Float_Flag=0;

uint8_t Gyro_Error_Flag=0;

//陀螺仪当前值
struct Gyro_Struct Gyro_Now={0,0};

//陀螺仪积分值(原始值、角度、弧度)
int64_t Gyro_Total;
int64_t Gyro_Total_NoFloat;
fp64 Gyro_Radian_Total;
fp64 Gyro_Angle_Total;

fp64 Gyro_Multiplier=1.0;//非线性系数
fp64 time_interval=1;

void Gyro_Update(void)
{
	Gyro_Total+=Gyro_Now.value;//1152 往大调是负偏
	//Gyro_Multiplier=PPoly_Eval(fabs(1000*Gyro_Radian_Step/time_interval),GREENGYRO);
	Gyro_Multiplier=1.0;
    
    Gyro_Total_NoFloat = Gyro_Total-Gyro_Float*Gyro_Now.count;
	
	Gyro_Angle_Total = Gyro_Total_NoFloat*0.0000001*Gyro_Convert1*Gyro_Multiplier;
	
	Gyro_Angle_Total=Gyro_Angle_Total-(int)(Gyro_Angle_Total/360)*360;
	
	if(Gyro_Angle_Total>180.0)
		Gyro_Angle_Total-=360.0;
	if(Gyro_Angle_Total<-180.0)
		Gyro_Angle_Total+=360.0;
	Gyro_Radian_Total=Gyro_Angle_Total*PI/180;
	
// 	LCD_WriteNumXY(Gyro_Angle_Total,0,0);
// 	LCD_WriteNumXY(Gyro_Float,0,1);

// 	switch((int)Float_State)
// 	{
// 		case Error:
// 			LCD_WriteStringXY("Error!",0,2);
// 			break;
// 		case Changed:
// 			LCD_WriteStringXY("Changed!",0,2);
// 			break; 
// 		case Normal:
// 			LCD_WriteStringXY("Normal!",0,2);
// 			break;
// 	}
}
// void Gyro_NonLinear(void)
// {
// 	Gyro_Radian_Total
// 	Gyro_Multiplier=PPoly_Eval(fabs(1000*Gyro_Radian_Step/time_interval),GREENGYRO);
// 	delay(1);
// }
void Gyro_CheckFloat(void)
{
	LED2_on;
	Gyro_Clear();
	Gyro_Float_Flag=1;
	Gyro_Float_Flag1=1;
	Gyro_Float_Flag2=1;
	while(Gyro_Float_Flag)
		delay(1);
	if(Gyro_Float_Total2-Gyro_Float_Total1==0)
		Float_State=CF_ERROR;
	else if(Int64Abs(Gyro_Float_Total2-Gyro_Float_Total1-Gyro_Float*1024)>40960)
	{
		Gyro_Float=(Gyro_Float_Total2-Gyro_Float_Total1)/1024;
		Float_State=CF_CHANGED;
		Data_Save();
	}
	else
	{
		Float_State=CF_NORMAL;
	}
	
	Gyro_Clear();
	LED2_off;
}
void Gyro_Init_P(void)
{
	Gyro_Convert1=3600*10000000.0/(fp64)Gyro_Total_NoFloat;
}
void Gyro_Init_N(void)
{
	Gyro_Convert2=-3600*10000000.0/(fp64)Gyro_Total_NoFloat;
}
void Gyro_Clear(void)
{
	Gyro_Total=0;
	Gyro_Now.count=0;
}
/********************************************************************************************************
Function:	Evaluate Piecewise Heimite Polynomial 
Created by 	.Somnus
Version 	1.0
*********************************************************************************************************/
fp64 PPoly_Eval(fp64 data,struct PPoly poly)
{
	fp64 result=1.13;
	int i;
	
	for (i=0;i<poly.num-1;i++)
	{
		if (data>poly.breaks[i]&&data<poly.breaks[i+1])
		{
			data=data-poly.breaks[i];
			result=poly.coefs[i][3]*pow(data,3)+poly.coefs[i][2]*
				pow(data,2)+poly.coefs[i][1]*pow(data,1)+poly.coefs[i][0];
			break;
		}
	}

	return result;
}

/********************************************************************************************************
Polynomials
Data acquired by Zhou Changxing
*********************************************************************************************************/
struct PPoly WHITEGYRO=
{17,
{0.00000,0.37400,0.74800,1.12200,1.49600,1.87000,2.24399,2.61799,2.99199,3.36599,3.73999,4.11399,4.48799,4.86199,5.23599,5.60999,5.98399,6.35799},
{{1.00000,0.00000,0.00000,0.00000},
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{1.07696,0.03410,-0.03582,0.12099}}
};

struct PPoly BLACKGYRO=
{17,
{0.00000,0.37400,0.74800,1.12200,1.49600,1.87000,2.24399,2.61799,2.99199,3.36599,3.73999,4.11399,4.48799,4.86199,5.23599,5.60999,5.98399,6.35799},
{{1.00000,0.00000,0.00000,0.00000},
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{1.07234,0.03706,-0.00875,0.09057}}
};


struct PPoly BLUEGYRO=
{17,
{0.00000,0.37400,0.74800,1.12200,1.49600,1.87000,2.24399,2.61799,2.99199,3.36599,3.73999,4.11399,4.48799,4.86199,5.23599,5.60999,5.98399,6.35799},
{{1.00000,0.00000,0.00000,0.00000},
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{1.07520,0.04294,0.15261,-0.13468}}
};

struct PPoly GREENGYRO=
{17,
{0.00000,0.37400,0.74800,1.12200,1.49600,1.87000,2.24399,2.61799,2.99199,3.36599,3.73999,4.11399,4.48799,4.86199,5.23599,5.60999,5.98399,6.35799},
{{1.00000,0.00000,0.00000,0.00000},
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{1.11959,0.12357,0.09803,-0.13286}}
};
